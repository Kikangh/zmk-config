## config/west.yml
```yaml
manifest:
  remotes:
    - name: zmkfirmware
      url-base: https://github.com/zmkfirmware
    - name: kikangh
      url-base: https://github.com/Kikangh
  projects:
    - name: zmk
      remote: kikangh
      revision: Sofle-mouse-HMtweaks
      import: app/west.yml
  self:
    path: config
```
